
/ {

    #define MAGIC_MACRO(NAME, BINDINGS) \
        NAME: NAME { \
            compatible = "zmk,behavior-macro"; \
            #binding-cells = <0>; \
            wait-ms = <0>; \
            tap-ms = <0>; \
            bindings = <&macro_tap BINDINGS>; \
        };

    MAGIC_MACRO(magicL_a, &kp T &kp I &kp O &kp N )
    MAGIC_MACRO(magicL_b, &kp J &kp E &kp C &kp T )
    MAGIC_MACRO(magicL_c, &kp A &kp U &kp S &kp E )
    MAGIC_MACRO(magicL_d, &kp I &kp T &kp I &kp O &kp N)
    MAGIC_MACRO(magicL_e, &kp M &kp E &kp N &kp T )
    MAGIC_MACRO(magicL_f, &kp E &kp R &kp E &kp N )
    MAGIC_MACRO(magicL_g, &kp E &kp N &kp E &kp R )
    MAGIC_MACRO(magicL_h, &kp O &kp U &kp L &kp D )
    MAGIC_MACRO(magicL_i, &kp O &kp N &kp A &kp L )
    MAGIC_MACRO(magicL_j, &kp E &kp C &kp T &kp I )
    MAGIC_MACRO(magicL_k, &kp N &kp O &kp W &kp L )
    MAGIC_MACRO(magicL_l, &kp A &kp T &kp I &kp O &kp N)
    MAGIC_MACRO(magicL_m, &kp E &kp M &kp B &kp E &kp R)
    MAGIC_MACRO(magicL_n, &kp M &kp E &kp N &kp T )
    MAGIC_MACRO(magicL_o, &kp T &kp H &kp E &kp R )
    MAGIC_MACRO(magicL_p, &kp O &kp I &kp N &kp T )
    MAGIC_MACRO(magicL_q, &kp U &kp E &kp S &kp T )
    MAGIC_MACRO(magicL_r, &kp I &kp G &kp H &kp T )
    MAGIC_MACRO(magicL_s, &kp S &kp I &kp O &kp N )
    MAGIC_MACRO(magicL_t, &kp I &kp O &kp N &kp S )
    MAGIC_MACRO(magicL_u, &kp N &kp D &kp E &kp R )
    MAGIC_MACRO(magicL_v, &kp I &kp S &kp I &kp O &kp N)
    MAGIC_MACRO(magicL_w, &kp O &kp R &kp L &kp D )
    MAGIC_MACRO(magicL_x, &kp P &kp E &kp R &kp I )
    MAGIC_MACRO(magicL_y, &kp S &kp T &kp E &kp M )
    MAGIC_MACRO(magicL_z, &kp Z &kp L &kp E &kp D )

    MAGIC_MACRO(magicL_space, &kp A &kp N &kp D &kp SPACE)
    MAGIC_MACRO(magicL_dot, &kp DOT &kp FSLH)
    MAGIC_MACRO(magicL_comm, &kp SPACE &kp A &kp N &kp D &kp SPACE)
    MAGIC_MACRO(magicL_hash, &kp D &kp E &kp F &kp I &kp N &kp E &kp SPACE)


    MAGIC_MACRO(magicR_a, &kp B &kp O &kp U &kp T )
    MAGIC_MACRO(magicR_b, &kp I &kp L &kp I &kp T )
    MAGIC_MACRO(magicR_c, &kp T &kp I &kp O &kp N )
    MAGIC_MACRO(magicR_d, &kp I &kp F &kp F &kp E &kp R)
    MAGIC_MACRO(magicR_e, &kp O &kp P &kp L &kp E )
    MAGIC_MACRO(magicR_f, &kp I &kp R &kp S &kp T )
    MAGIC_MACRO(magicR_g, &kp O &kp V &kp E &kp R &kp N)
    MAGIC_MACRO(magicR_h, &kp O &kp U &kp G &kp H )
    MAGIC_MACRO(magicR_i, &kp T &kp I &kp O &kp N )
    MAGIC_MACRO(magicR_j, &kp E &kp C &kp T &kp S )
    MAGIC_MACRO(magicR_k, &kp N &kp O &kp W &kp N )
    MAGIC_MACRO(magicR_l, &kp I &kp G &kp H &kp T )
    MAGIC_MACRO(magicR_m, &kp E &kp N &kp T &kp S )
    MAGIC_MACRO(magicR_n, &kp A &kp T &kp I &kp O &kp N)
    MAGIC_MACRO(magicR_o, &kp U &kp G &kp H &kp T )
    MAGIC_MACRO(magicR_p, &kp E &kp O &kp P &kp L &kp E)
    MAGIC_MACRO(magicR_q, &kp U &kp I &kp R &kp E )
    MAGIC_MACRO(magicR_r, &kp O &kp U &kp G &kp H )
    MAGIC_MACRO(magicR_s, &kp H &kp O &kp U &kp L &kp D)
    MAGIC_MACRO(magicR_t, &kp H &kp E &kp R &kp E )
    MAGIC_MACRO(magicR_u, &kp T &kp I &kp O &kp N )
    MAGIC_MACRO(magicR_v, &kp E &kp L &kp O &kp P )
    MAGIC_MACRO(magicR_w, &kp H &kp E &kp R &kp E )
    MAGIC_MACRO(magicR_x, &kp P &kp E &kp C &kp T )
    MAGIC_MACRO(magicR_y, &kp O &kp U &kp N &kp G )
    MAGIC_MACRO(magicR_z, &kp A &kp T &kp I &kp O &kp N)

    MAGIC_MACRO(magicR_space, &kp T &kp H &kp E &kp SPACE)
    MAGIC_MACRO(magicR_dot, &kp DOT &kp DOT)
    MAGIC_MACRO(magicR_comm, &kp SPACE &kp B &kp U &kp T &kp SPACE)
    MAGIC_MACRO(magicR_hash, &kp I &kp N &kp C &kp L &kp U &kp D &kp E &kp SPACE)

    #define DEAD_ANTE 0x070100

    labeled_dead_ante: labeled_key_repeat {
        compatible = "zmk,behavior-macro";
        label = "labeled_dead_ante";
        #binding-cells = <0>;
        wait-ms = <0>;
        tap-ms = <0>;
        bindings = <&macro_tap &kp DEAD_ANTE>;
    };

    magicL: magicL {
        compatible = "zmk,behavior-antecedent-morph";
        #binding-cells = <0>;
        max-delay-ms = <ADAPTIVE_KEY_TIMEOUT>;
        defaults = <&labeled_dead_ante>;
        antecedents = <
                       A B C D E F G H I J K L M N O P Q R S T U V W X Y Z SPACE DOT COMMA HASH >;
        bindings =    <
                       &magicL_a &magicL_b &magicL_c &magicL_d &magicL_e &magicL_f &magicL_g &magicL_h &magicL_i &magicL_j &magicL_k &magicL_l &magicL_m &magicL_n &magicL_o
                       &magicL_p &magicL_q &magicL_r &magicL_s &magicL_t &magicL_u &magicL_v &magicL_w &magicL_x &magicL_y &magicL_z &magicL_space &magicL_dot &magicL_comm &magicL_hash >;
    };

    magicR: magicR {
        compatible = "zmk,behavior-antecedent-morph";
        #binding-cells = <0>;
        max-delay-ms = <ADAPTIVE_KEY_TIMEOUT>;
        defaults = <&labeled_dead_ante>;
        antecedents = <
                       A B C D E F G H I J K L M N O P Q R S T U V W X Y Z SPACE DOT COMMA HASH >;
        bindings =    <
                       &magicR_a &magicR_b &magicR_c &magicR_d &magicR_e &magicR_f &magicR_g &magicR_h &magicR_i &magicR_j &magicR_k &magicR_l &magicR_m &magicR_n &magicR_o
                       &magicR_p &magicR_q &magicR_r &magicR_s &magicR_t &magicR_u &magicR_v &magicR_w &magicR_x &magicR_y &magicR_z &magicR_space &magicR_dot &magicR_comm &magicR_hash >;
    };

};